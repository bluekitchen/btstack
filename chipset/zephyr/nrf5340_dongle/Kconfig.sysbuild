## chipset/zephyr/nrf5340_dongle/Kconfig.sysbuild
```kconfig
#
# Copyright (c) 2024 Nordic Semiconductor
#
# SPDX-License-Identifier: LicenseRef-Nordic-5-Clause
#

config NRF_DEFAULT_IPC_RADIO
	default y

source "${ZEPHYR_BASE}/share/sysbuild/Kconfig"
```

## port/esp32/components/btstack/Kconfig.projbuild
```kconfig
menu "Example Board Configuration"

choice ESP32_BOARD
    prompt "ESP32 board"
    default ESP_CUSTOM_BOARD
    help 
        select an ESP32 board to use with BTstack.

config ESP_LYRAT_V4_3_BOARD
    bool "ESP32-Lyrat V4.3"
config ESP_CUSTOM_BOARD
    bool "ESP32 custom board"

endchoice

endmenu
```

## port/esp32/sdkconfig.defaults
```kconfig
#
# Bluetooth
#
CONFIG_BT_ENABLED=y
CONFIG_BT_BLUEDROID_ENABLED=n
CONFIG_BT_CONTROLLER_ONLY=y

#
# Bluetooth Dual Mode
#
CONFIG_BTDM_CTRL_MODE_BTDM=y
CONFIG_BTDM_CTRL_MODE_BR_EDR_ONLY=n
CONFIG_BTDM_CTRL_BR_EDR_SCO_DATA_PATH_HCI=y

# LC3 codec requires additional memory, default on ESP32-S3 is 3584
CONFIG_ESP_MAIN_TASK_STACK_SIZE=8192

# Make btstack get time ms useful
CONFIG_FREERTOS_HZ=1000
```

## port/esp32/template/sdkconfig.defaults
```kconfig
CONFIG_IDF_TARGET_ESP32=y

#
# Bluetooth
#
CONFIG_BT_ENABLED=y
CONFIG_BT_CTRL_ESP32=y
CONFIG_BT_BLUEDROID_ENABLED=n
CONFIG_BT_CONTROLLER_ONLY=y

#
# Bluetooth Dual Mode
#
CONFIG_BTDM_CTRL_MODE_BTDM=y
CONFIG_BTDM_CTRL_MODE_BR_EDR_ONLY=n
```

## port/nrf5-zephyr/Kconfig
```kconfig
menuconfig BTSTACK
	bool "BTstack support"
	default n
	help
	  This option enables the BTstack Bluetooth stack.
```

## port/zephyr/boards/ezurio/if310/Kconfig
```kconfig
# SPDX-License-Identifier: Apache-2.0

config BOARD_IF310
	select RP2_FLASH_W25Q080
```

## port/zephyr/boards/ezurio/if310/board.yml
```yaml
board:
  name: if310
  full_name: IF310 Development Board
  vendor: ezurio
  socs:
  - name: rp2040
```
