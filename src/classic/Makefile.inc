# Makefile to collect all C source files of src/classic

SRC_CLASSIC_FILES = \
    a2dp_sink.c \
    a2dp_source.c \
    avdtp.c \
    avdtp_acceptor.c \
    avdtp_initiator.c \
    avdtp_sink.c \
    avdtp_source.c \
    avdtp_util.c \
    avrcp.c \
    avrcp_browsing_controller.c \
    avrcp_browsing_target.c \
    avrcp_controller.c \
    avrcp_media_item_iterator.c \
    avrcp_target.c \
    bnep.c \
    btstack_cvsd_plc.c \
    btstack_link_key_db_memory.c \
    btstack_link_key_db_static.c \
    btstack_link_key_db_tlv.c \
    btstack_sbc_decoder_bluedroid.c \
    btstack_sbc_encoder_bluedroid.c \
    btstack_sbc_plc.c \
    device_id_server.c \
    goep_client.c \
    hfp.c \
    hfp_ag.c \
    hfp_gsm_model.c \
    hfp_hf.c \
    hfp_msbc.c \
    hid_device.c \
    hsp_ag.c \
    hsp_hs.c \
    obex_iterator.c \
    pan.c \
    pbap_client.c \
    rfcomm.c \
    sdp_client.c \
    sdp_client_rfcomm.c \
    sdp_server.c \
    sdp_util.c \
    spp_server.c \

