## port/esp32/components/btstack/Kconfig
```kconfig
menu "BTstack Configuration"

config BTSTACK_AUDIO
    bool "I2S Audio driver"
    default n
    help
        Select this option to enable BTstack's audio driver

config BTSTACK_INTERNAL_BT
    bool "Support for SoC Bluetooth" if BT_CONTROLLER_ONLY && !BTSTACK_EXTERNAL_UART_BT
    default y if BT_CONTROLLER_ONLY && !BTSTACK_EXTERNAL_UART_BT
    help
        Select this option to enable the chips build in
        Bluetooth support

config BTSTACK_HCI_DUMP_STDOUT
    bool "Dump HCI traffic to stdout"
    default n
    help
        For debugging purpose this will output all received
        and send packages

menuconfig BTSTACK_EXTERNAL_UART_BT
    bool "Support for externally connected UART Bluetooth modules"
    default n
    help
        Select this option if you want to be able to connect
        to a dedicated external Bluetooth module

if BTSTACK_EXTERNAL_UART_BT
    choice BTSTACK_EXTERNAL_UART_BT_CONTROLLER_MODE
        prompt "External Bluetooth controller mode"
        default BTSTACK_EXTERNAL_UART_BT_DUAL_MODE
        help
            Select the Bluetooth transport capabilities of the externally
            connected controller. BTstack uses this to enable only the
            matching Classic and/or LE features and examples.

        config BTSTACK_EXTERNAL_UART_BT_LE_ONLY
            bool "LE only"

        config BTSTACK_EXTERNAL_UART_BT_CLASSIC_ONLY
            bool "Classic only"

        config BTSTACK_EXTERNAL_UART_BT_DUAL_MODE
            bool "Dual-mode (Classic and LE)"
    endchoice

    config BTSTACK_UART_NUM
        int "UART to use"
        default 0
    config BTSTACK_UART_INVERT_RTS
        bool "Invert RTS"
        default n
    config BTSTACK_UART_TX_PIN
        int "Pin number for TX"
        default -1
    config BTSTACK_UART_RX_PIN
        int "Pin number for RX"
        default -1
    config BTSTACK_UART_RTS_PIN
        int "Pin number for RTS"
        default -1
    config BTSTACK_UART_CTS_PIN
        int "Pin number for CTS"
        default -1
    config BTSTACK_UART_NRESET_PIN
        int "Pin number for nReset"
        default -1
    config BT
endif

endmenu
```

## port/zephyr/boards/nucleo_h563zi.conf
```kconfig
# Config persistent storage
CONFIG_USE_DT_CODE_PARTITION=y
CONFIG_FLASH=y
CONFIG_SOC_FLASH_STM32=y
CONFIG_MPU_ALLOW_FLASH_WRITE=y

## Configure for CYW555xx over UART
CONFIG_UART_INTERRUPT_DRIVEN=y

CONFIG_BT_HCI_RAW=y

CONFIG_BT_AIROC_CUSTOM=y
# CYW55573 (CYW55560A1)
#CONFIG_CYW55572=y
#CONFIG_AIROC_CUSTOM_FIRMWARE_HCD_BLOB="CYW55560A1_001.002.087.0415.0000_Generic_UART_37_4MHz_fcbga_iPA_sLNA_ANT0.hcd"
# CYW55513 (CYW55500A1)
#CONFIG_CYW55500=y
CONFIG_AIROC_CUSTOM_FIRMWARE_HCD_BLOB="CYW55500A1_001.002.032.0253.0000_Generic_UART_37_4MHz_wlbga_iPA_sLNA_ANT0.hcd"

CONFIG_AIROC_AUTOBAUD_MODE=y
```
